## config/boards/shields/tp-marking-keyboard/Kconfig.defconfig
```kconfig
if SHIELD_TP_MARKING_KEYBOARD

config ZMK_KEYBOARD_NAME
  default "TP Keyboard"

endif
```

## config/boards/shields/tp-marking-keyboard/Kconfig.shield
```kconfig
config SHIELD_TP_MARKING_KEYBOARD
  def_bool $(shields_list_contains, tp_marking_keyboard)
```
